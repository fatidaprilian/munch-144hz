l11r_38_08_0a_dsc_cmd {
				qcom,mdss-dsi-panel-name = "xiaomi 38 08 0a cmd mode dsc dsi panel";
				qcom,mdss-dsi-panel-type = "dsi_cmd_mode";
				qcom,mdss-dsi-panel-physical-type = "oled";
				qcom,mdss-dsi-virtual-channel-id = <0x00>;
				qcom,mdss-dsi-stream = <0x00>;
				qcom,mdss-dsi-bpp = <0x18>;
				qcom,mdss-dsi-color-order = "rgb_swap_rgb";
				qcom,mdss-dsi-underflow-color = <0xff>;
				qcom,mdss-dsi-border-color = <0x00>;
				qcom,dsi-ctrl-num = <0x00>;
				qcom,dsi-phy-num = <0x00>;
				qcom,mdss-dsi-traffic-mode = "burst_mode";
				qcom,mdss-dsi-lane-map = "lane_map_0123";
				qcom,mdss-dsi-bllp-eof-power-mode;
				qcom,mdss-dsi-bllp-power-mode;
				qcom,mdss-dsi-lane-0-state;
				qcom,mdss-dsi-lane-1-state;
				qcom,mdss-dsi-lane-2-state;
				qcom,mdss-dsi-lane-3-state;
				qcom,mdss-dsi-dma-trigger = "trigger_sw";
				qcom,mdss-dsi-mdp-trigger = "none";
				qcom,mdss-dsi-reset-sequence = <0x00 0x0c 0x01 0x0a>;
				qcom,mdss-dsi-reset-powerdown-delay = <0x0a>;
				qcom,mdss-pan-physical-width-dimension = <0x46>;
				qcom,mdss-pan-physical-height-dimension = <0x9b>;
				qcom,mdss-dsi-te-pin-select = <0x01>;
				qcom,mdss-dsi-wr-mem-start = <0x2c>;
				qcom,mdss-dsi-wr-mem-continue = <0x3c>;
				qcom,mdss-dsi-te-dcs-command = <0x01>;
				qcom,mdss-dsi-te-check-enable;
				qcom,mdss-dsi-te-using-te-pin;
				qcom,mdss-dsi-tx-eot-append;
				qcom,mdss-dsi-lp11-init;
				qcom,mdss-dsi-panel-hdr-enabled;
				qcom,mdss-dsi-panel-hdr-color-primaries = <0x38a4 0x3c8c 0x7d00 0x4268 0x3c8c 0x7530 0x1f40 0xbb8>;
				qcom,mdss-dsi-panel-peak-brightness = <0x401640>;
				qcom,mdss-dsi-panel-blackness-level = <0xc9e>;
				qcom,bl-update-flag = "delay_until_first_frame";
				mi,mdss-dsi-bl-dcs-big-endian-type;
				mi,feature-enabled;
				mi,mdss-dsi-panel-hbm-51-ctrl-flag;
				mi,mdss-dsi-panel-hbm-off-51-index = <0x01>;
				mi,esd-err-irq-gpio = <0xffffffff 0x33 0x2001>;
				mi,mdss-panel-on-dimming-delay = <0x78>;
				mi,mdss-dsi-panel-hbm-brightness = <0x01>;
				mi,mdss-dsi-panel-dc-threshold = <0x1b8>;
				mi,mdss-dsi-panel-max-brightness-clone = <0xfff>;
				qcom,dsi-select-clocks = "mux_byte_clk0\0mux_pixel_clk0\0src_byte_clk0\0src_pixel_clk0\0shadow_byte_clk0\0shadow_pixel_clk0";
				qcom,mdss-dsi-clk-strength = <0xff>;
				qcom,panel-supply-entries = <0x24>;
				qcom,mdss-dsi-bl-pmic-control-type = "bl_ctrl_dcs";
				qcom,mdss-dsi-bl-min-level = <0x01>;
				qcom,mdss-dsi-bl-max-level = <0x7ff>;
				qcom,mdss-brightness-max-level = <0x7ff>;
				qcom,mdss-brightness-init-level = <0x218>;
				qcom,platform-te-gpio = <0xffffffff 0x42 0x00>;
				qcom,platform-reset-gpio = <0xffffffff 0x0c 0x00>;
				qcom,ulps-enabled;
				phandle = <0x46>;

				qcom,mdss-dsi-display-timings {

					timing@0 {
						qcom,mdss-dsi-panel-framerate = <0x3c>;
						qcom,mdss-dsi-panel-width = <0x438>;
						qcom,mdss-dsi-panel-height = <0x960>;
						qcom,mdss-dsi-h-front-porch = <0x10>;
						qcom,mdss-dsi-h-back-porch = <0x08>;
						qcom,mdss-dsi-h-pulse-width = <0x08>;
						qcom,mdss-dsi-h-sync-skew = <0x00>;
						qcom,mdss-dsi-v-back-porch = <0x230>;
						qcom,mdss-dsi-v-front-porch = <0x258>;
						qcom,mdss-dsi-v-pulse-width = <0x20>;
						qcom,mdss-dsi-h-sync-pulse = <0x00>;
						qcom,mdss-dsi-h-left-border = <0x00>;
						qcom,mdss-dsi-h-right-border = <0x00>;
						qcom,mdss-dsi-v-top-border = <0x00>;
						qcom,mdss-dsi-v-bottom-border = <0x00>;
						qcom,mdss-dsi-panel-clockrate = <0x4190ab00>;
						qcom,mdss-dsi-panel-jitter = <0x05 0x01>;
						qcom,mdss-mdp-transfer-time-us = <0x36b0>;
						qcom,mdss-dsi-on-command = [05 01 00 00 0a 00 02 11 00 39 01 00 00 00 00 02 35 00 39 01 00 00 00 00 02 9d 01 39 01 00 00 00 00 81 9e 11 00 00 89 30 80 09 60 04 38 00 08 02 1c 02 1c 02 00 02 0e 00 20 00 bb 00 07 00 0c 0d b7 0c b7 18 00 10 f0 03 0c 20 00 06 0b 0b 33 0e 1c 2a 38 46 54 62 69 70 77 79 7b 7d 7e 01 02 01 00 09 40 09 be 19 fc 19 fa 19 f8 1a 38 1a 78 1a b6 2a f6 2b 34 2b 74 3b 74 6b f4 00 00 00 00 00 00 00 00 00 00 00 00 00 00 00 00 00 00 00 00 00 00 00 00 00 00 00 00 00 00 00 00 00 00 00 00 00 00 00 00 39 00 00 00 00 00 05 2a 00 00 04 37 39 01 00 00 00 00 05 2b 00 00 09 5f 39 01 00 00 00 00 03 f0 5a 5a 39 00 00 00 00 00 02 b0 01 39 01 00 00 00 00 02 b7 4f 39 01 00 00 00 00 03 f0 a5 a5 39 01 00 00 00 00 03 f0 5a 5a 39 00 00 00 00 00 02 b0 02 39 00 00 00 00 00 05 ec 00 c0 c3 43 39 00 00 00 00 00 02 b0 0d 39 00 00 00 00 00 02 ec 19 39 00 00 00 00 00 02 b0 06 39 01 00 00 00 00 02 e4 d0 39 01 00 00 00 00 03 f0 a5 a5 39 01 00 00 00 00 03 f0 5a 5a 39 00 00 00 00 00 02 b0 36 39 00 00 00 00 00 02 d3 0f 39 01 00 00 00 00 02 f7 03 39 01 00 00 00 00 03 f0 a5 a5 39 01 00 00 00 00 03 f0 5a 5a 39 01 00 00 00 00 03 fc 5a 5a 39 00 00 00 00 00 02 b0 01 39 00 00 00 00 00 04 e4 a6 75 a3 39 01 00 00 00 00 0f e9 11 75 a6 75 a3 8d 06 20 8c a2 4e 00 32 32 39 01 00 00 00 00 03 fc a5 a5 39 01 00 00 00 00 03 f0 a5 a5 39 01 00 00 00 00 03 f0 5a 5a 39 00 00 00 00 00 04 df 83 00 10 39 00 00 00 00 00 02 b0 01 39 01 00 00 00 00 02 e6 01 39 01 00 00 00 00 03 f0 a5 a5 39 00 00 00 00 00 03 f0 5a 5a 39 00 00 00 00 00 02 b0 08 39 00 00 00 00 00 02 d4 05 39 01 00 00 00 00 03 f0 a5 a5 39 01 00 00 00 00 03 f0 5a 5a 39 01 00 00 00 00 03 fc 5a 5a 39 00 00 00 00 00 02 b0 16 39 01 00 00 00 00 02 d1 2e 39 01 00 00 00 00 03 fc a5 a5 39 01 00 00 5a 00 03 f0 a5 a5 39 01 00 00 00 00 03 f0 5a 5a 39 00 00 00 00 00 02 b0 06 39 00 00 00 00 00 02 b7 10 39 00 00 00 00 00 02 b0 05 39 01 00 00 00 00 02 b7 93 39 01 00 00 00 00 03 f0 a5 a5 39 01 00 00 00 00 02 53 20 39 01 00 00 00 00 03 51 00 00 05 01 00 00 00 00 02 29 00 39 01 00 00 00 00 02 60 00];
						qcom,mdss-dsi-off-command = [05 01 00 00 14 00 02 28 00 39 01 00 00 00 00 02 53 20 05 01 00 00 78 00 02 10 00];
						qcom,mdss-dsi-on-command-state = "dsi_lp_mode";
						qcom,mdss-dsi-off-command-state = "dsi_lp_mode";
						qcom,mdss-dsi-timing-switch-command = [39 00 00 00 00 00 02 60 00 39 00 00 00 00 00 03 f0 5a 5a 39 00 00 00 00 00 03 fc 5a 5a 39 00 00 00 00 00 02 b0 16 39 00 00 00 00 00 02 d1 2e 39 00 00 00 00 00 03 fc a5 a5 39 01 00 00 0c 00 03 f0 a5 a5];
						qcom,mdss-dsi-timing-switch-command-state = "dsi_lp_mode";
						qcom,mdss-dsi-nolp-command = [39 01 00 00 00 00 03 f0 5a 5a 39 00 00 00 00 00 02 b0 0a 39 00 00 00 00 00 02 ee 06 39 00 00 00 00 00 02 b0 0b 39 00 00 00 00 00 03 d8 59 70 39 00 00 00 00 00 02 60 00 39 00 00 00 00 00 03 fc 5a 5a 39 00 00 00 00 00 02 b0 16 39 00 00 00 00 00 02 d1 2e 39 00 00 00 00 00 03 fc a5 a5 39 01 00 00 00 00 02 53 28 39 01 00 00 11 00 03 f0 a5 a5];
						qcom,mdss-dsi-nolp-command-state = "dsi_lp_mode";
						qcom,compression-mode = "dsc";
						qcom,mdss-dsc-slice-height = <0x08>;
						qcom,mdss-dsc-slice-width = <0x21c>;
						qcom,mdss-dsc-slice-per-pkt = <0x02>;
						qcom,mdss-dsc-bit-per-component = <0x08>;
						qcom,mdss-dsc-bit-per-pixel = <0x08>;
						qcom,mdss-dsc-block-prediction-enable;
						mi,mdss-dsi-dimmingon-command = [39 01 00 00 00 00 02 53 28];
						mi,mdss-dsi-dimmingon-command-state = "dsi_hs_mode";
						mi,mdss-dsi-dimmingoff-command = [39 01 00 00 00 00 02 53 20];
						mi,mdss-dsi-dimmingoff-command-state = "dsi_hs_mode";
						mi,mdss-dsi-hbm-on-command = [39 01 00 00 00 00 02 53 e8 39 01 00 00 00 00 03 51 00 00];
						mi,mdss-dsi-hbm-off-command = [39 01 00 00 00 00 02 53 28 39 01 00 00 00 00 03 51 07 ff];
						mi,mdss-dsi-hbm-on-command-state = "dsi_lp_mode";
						mi,mdss-dsi-hbm-off-command-state = "dsi_lp_mode";
						mi,mdss-dsi-doze-hbm-command = [05 01 00 00 00 00 02 28 00 39 00 00 00 00 00 03 f0 5a 5a 39 00 00 00 00 00 02 60 00 39 00 00 00 00 00 03 fc 5a 5a 39 00 00 00 00 00 02 b0 16 39 00 00 00 00 00 02 d1 2e 39 00 00 00 00 00 03 fc a5 a5 39 00 00 00 00 00 02 b0 0b 39 00 00 00 00 00 03 d8 50 00 39 00 00 00 00 00 02 53 22 39 01 00 00 22 00 03 f0 a5 a5 05 01 00 00 00 00 02 29 00];
						mi,mdss-dsi-doze-lbm-command = [05 01 00 00 00 00 02 28 00 39 00 00 00 00 00 03 f0 5a 5a 39 00 00 00 00 00 02 60 00 39 00 00 00 00 00 03 fc 5a 5a 39 00 00 00 00 00 02 b0 16 39 00 00 00 00 00 02 d1 2e 39 00 00 00 00 00 03 fc a5 a5 39 00 00 00 00 00 02 b0 0b 39 00 00 00 00 00 03 d8 50 00 39 00 00 00 00 00 02 53 23 39 01 00 00 22 00 03 f0 a5 a5 05 01 00 00 00 00 02 29 00];
						mi,mdss-dsi-doze-hbm-command-state = "dsi_lp_mode";
						mi,mdss-dsi-doze-lbm-command-state = "dsi_lp_mode";
						mi,mdss-dsi-flat-on-command = [39 00 00 00 00 00 03 f0 5a 5a 39 00 00 00 00 00 03 c2 2d 27 39 00 00 00 00 00 0f e0 82 13 13 13 86 fc 08 80 00 00 00 00 ff 90 39 00 00 00 00 00 02 f7 03 39 01 00 00 09 00 03 f0 a5 a5];
						mi,mdss-dsi-flat-off-command = <0x39000000 0x3f0 0x5a5a3900 0x00 0x3c22d07 0x39000000 0x2e0 0x390000 0x02 0xf7033901 0x900 0x3f0a5a5>;
						mi,mdss-dsi-flat-on-command-state = "dsi_lp_mode";
						mi,mdss-dsi-flat-off-command-state = "dsi_lp_mode";
						mi,mdss-dsi-crc-off-command = [39 01 00 00 00 00 02 81 00 39 00 00 00 00 00 03 f0 5a 5a 39 00 00 00 00 00 02 b1 01 39 01 00 00 00 00 03 f0 a5 a5];
						mi,mdss-dsi-crc-off-command-state = "dsi_hs_mode";
						qcom,mdss-dsi-panel-phy-timings = [00 24 0a 0a 26 24 0a 0a 06 02 04 00 1e 1a];
						qcom,display-topology = <0x01 0x01 0x01>;
						qcom,default-topology-index = <0x00>;
					};

					timing@1 {
						qcom,mdss-dsi-panel-framerate = <0x78>;
						qcom,mdss-dsi-panel-width = <0x438>;
						qcom,mdss-dsi-panel-height = <0x960>;
						qcom,mdss-dsi-h-front-porch = <0x10>;
						qcom,mdss-dsi-h-back-porch = <0x08>;
						qcom,mdss-dsi-h-pulse-width = <0x08>;
						qcom,mdss-dsi-h-sync-skew = <0x00>;
						qcom,mdss-dsi-v-back-porch = <0x08>;
						qcom,mdss-dsi-v-front-porch = <0x04>;
						qcom,mdss-dsi-v-pulse-width = <0x04>;
						qcom,mdss-dsi-h-sync-pulse = <0x00>;
						qcom,mdss-dsi-h-left-border = <0x00>;
						qcom,mdss-dsi-h-right-border = <0x00>;
						qcom,mdss-dsi-v-top-border = <0x00>;
						qcom,mdss-dsi-v-bottom-border = <0x00>;
						qcom,mdss-dsi-panel-clockrate = <0x4190ab00>;
						qcom,mdss-dsi-panel-jitter = <0x05 0x01>;
						qcom,mdss-mdp-transfer-time-us = <0x1b58>;
						qcom,mdss-dsi-on-command = [05 01 00 00 0a 00 02 11 00 39 01 00 00 00 00 02 35 00 39 01 00 00 00 00 02 9d 01 39 01 00 00 00 00 81 9e 11 00 00 89 30 80 09 60 04 38 00 08 02 1c 02 1c 02 00 02 0e 00 20 00 bb 00 07 00 0c 0d b7 0c b7 18 00 10 f0 03 0c 20 00 06 0b 0b 33 0e 1c 2a 38 46 54 62 69 70 77 79 7b 7d 7e 01 02 01 00 09 40 09 be 19 fc 19 fa 19 f8 1a 38 1a 78 1a b6 2a f6 2b 34 2b 74 3b 74 6b f4 00 00 00 00 00 00 00 00 00 00 00 00 00 00 00 00 00 00 00 00 00 00 00 00 00 00 00 00 00 00 00 00 00 00 00 00 00 00 00 00 39 00 00 00 00 00 05 2a 00 00 04 37 39 01 00 00 00 00 05 2b 00 00 09 5f 39 01 00 00 00 00 03 f0 5a 5a 39 00 00 00 00 00 02 b0 01 39 01 00 00 00 00 02 b7 4f 39 01 00 00 00 00 03 f0 a5 a5 39 01 00 00 00 00 03 f0 5a 5a 39 00 00 00 00 00 02 b0 02 39 00 00 00 00 00 05 ec 00 c0 c3 43 39 00 00 00 00 00 02 b0 0d 39 00 00 00 00 00 02 ec 19 39 00 00 00 00 00 02 b0 06 39 01 00 00 00 00 02 e4 d0 39 01 00 00 00 00 03 f0 a5 a5 39 01 00 00 00 00 03 f0 5a 5a 39 00 00 00 00 00 02 b0 36 39 00 00 00 00 00 02 d3 0f 39 01 00 00 00 00 02 f7 03 39 01 00 00 00 00 03 f0 a5 a5 39 01 00 00 00 00 03 f0 5a 5a 39 01 00 00 00 00 03 fc 5a 5a 39 00 00 00 00 00 02 b0 01 39 00 00 00 00 00 04 e4 a6 75 a3 39 01 00 00 00 00 0f e9 11 75 a6 75 a3 8d 06 20 8c a2 4e 00 32 32 39 01 00 00 00 00 03 fc a5 a5 39 01 00 00 00 00 03 f0 a5 a5 39 01 00 00 00 00 03 f0 5a 5a 39 00 00 00 00 00 04 df 83 00 10 39 00 00 00 00 00 02 b0 01 39 01 00 00 00 00 02 e6 01 39 01 00 00 00 00 03 f0 a5 a5 39 00 00 00 00 00 03 f0 5a 5a 39 00 00 00 00 00 02 b0 08 39 00 00 00 00 00 02 d4 05 39 01 00 00 00 00 03 f0 a5 a5 39 01 00 00 00 00 03 f0 5a 5a 39 01 00 00 00 00 03 fc 5a 5a 39 00 00 00 00 00 02 b0 16 39 01 00 00 00 00 02 d1 2e 39 01 00 00 00 00 03 fc a5 a5 39 01 00 00 5a 00 03 f0 a5 a5 39 01 00 00 00 00 03 f0 5a 5a 39 00 00 00 00 00 02 b0 06 39 00 00 00 00 00 02 b7 10 39 00 00 00 00 00 02 b0 05 39 01 00 00 00 00 02 b7 93 39 01 00 00 00 00 03 f0 a5 a5 39 00 00 00 00 00 02 53 20 39 01 00 00 00 00 03 51 00 00 05 01 00 00 00 00 02 29 00 39 01 00 00 00 00 02 60 10];
						qcom,mdss-dsi-off-command = [05 01 00 00 14 00 02 28 00 39 01 00 00 00 00 02 53 20 05 01 00 00 78 00 02 10 00];
						qcom,mdss-dsi-on-command-state = "dsi_lp_mode";
						qcom,mdss-dsi-off-command-state = "dsi_lp_mode";
						qcom,mdss-dsi-timing-switch-command = [39 00 00 00 00 00 02 60 10 39 00 00 00 00 00 03 f0 5a 5a 39 00 00 00 00 00 03 fc 5a 5a 39 00 00 00 00 00 02 b0 16 39 00 00 00 00 00 02 d1 2e 39 00 00 00 00 00 03 fc a5 a5 39 01 00 00 00 00 03 f0 a5 a5];
						qcom,mdss-dsi-timing-switch-command-state = "dsi_lp_mode";
						qcom,mdss-dsi-nolp-command = [39 01 00 00 00 00 03 f0 5a 5a 39 00 00 00 00 00 02 b0 0a 39 00 00 00 00 00 02 ee 06 39 00 00 00 00 00 02 b0 0b 39 00 00 00 00 00 03 d8 59 70 39 00 00 00 00 00 02 60 10 39 00 00 00 00 00 03 fc 5a 5a 39 00 00 00 00 00 02 b0 16 39 00 00 00 00 00 02 d1 2e 39 00 00 00 00 00 03 fc a5 a5 39 01 00 00 00 00 02 53 28 39 01 00 00 09 00 03 f0 a5 a5];
						qcom,mdss-dsi-nolp-command-state = "dsi_lp_mode";
						qcom,compression-mode = "dsc";
						qcom,mdss-dsc-slice-height = <0x08>;
						qcom,mdss-dsc-slice-width = <0x21c>;
						qcom,mdss-dsc-slice-per-pkt = <0x02>;
						qcom,mdss-dsc-bit-per-component = <0x08>;
						qcom,mdss-dsc-bit-per-pixel = <0x08>;
						qcom,mdss-dsc-block-prediction-enable;
						mi,mdss-dsi-dimmingon-command = [39 01 00 00 00 00 02 53 28];
						mi,mdss-dsi-dimmingon-command-state = "dsi_hs_mode";
						mi,mdss-dsi-dimmingoff-command = [39 01 00 00 00 00 02 53 20];
						mi,mdss-dsi-dimmingoff-command-state = "dsi_hs_mode";
						mi,mdss-dsi-hbm-on-command = [39 01 00 00 00 00 02 53 e8 39 01 00 00 00 00 03 51 00 00];
						mi,mdss-dsi-hbm-off-command = [39 01 00 00 00 00 02 53 28 39 01 00 00 00 00 03 51 07 ff];
						mi,mdss-dsi-hbm-on-command-state = "dsi_lp_mode";
						mi,mdss-dsi-hbm-off-command-state = "dsi_lp_mode";
						mi,mdss-dsi-doze-hbm-command = [05 01 00 00 00 00 02 28 00 39 00 00 00 00 00 03 f0 5a 5a 39 00 00 00 00 00 02 60 00 39 00 00 00 00 00 03 fc 5a 5a 39 00 00 00 00 00 02 b0 16 39 00 00 00 00 00 02 d1 2e 39 00 00 00 00 00 03 fc a5 a5 39 00 00 00 00 00 02 b0 0b 39 00 00 00 00 00 03 d8 50 00 39 00 00 00 00 00 02 53 22 39 01 00 00 22 00 03 f0 a5 a5 05 01 00 00 00 00 02 29 00];
						mi,mdss-dsi-doze-lbm-command = [05 01 00 00 00 00 02 28 00 39 00 00 00 00 00 03 f0 5a 5a 39 00 00 00 00 00 02 60 00 39 00 00 00 00 00 03 fc 5a 5a 39 00 00 00 00 00 02 b0 16 39 00 00 00 00 00 02 d1 2e 39 00 00 00 00 00 03 fc a5 a5 39 00 00 00 00 00 02 b0 0b 39 00 00 00 00 00 03 d8 50 00 39 00 00 00 00 00 02 53 23 39 01 00 00 22 00 03 f0 a5 a5 05 01 00 00 00 00 02 29 00];
						mi,mdss-dsi-doze-hbm-command-state = "dsi_lp_mode";
						mi,mdss-dsi-doze-lbm-command-state = "dsi_lp_mode";
						mi,mdss-dsi-flat-on-command = [39 00 00 00 00 00 03 f0 5a 5a 39 00 00 00 00 00 03 c2 2d 27 39 00 00 00 00 00 0f e0 82 13 13 13 86 fc 08 80 00 00 00 00 ff 90 39 00 00 00 00 00 02 f7 03 39 01 00 00 09 00 03 f0 a5 a5];
						mi,mdss-dsi-flat-off-command = <0x39000000 0x3f0 0x5a5a3900 0x00 0x3c22d07 0x39000000 0x2e0 0x390000 0x02 0xf7033901 0x900 0x3f0a5a5>;
						mi,mdss-dsi-flat-on-command-state = "dsi_lp_mode";
						mi,mdss-dsi-flat-off-command-state = "dsi_lp_mode";
						mi,mdss-dsi-crc-off-command = [39 01 00 00 00 00 02 81 00 39 00 00 00 00 00 03 f0 5a 5a 39 00 00 00 00 00 02 b1 01 39 01 00 00 00 00 03 f0 a5 a5];
						mi,mdss-dsi-crc-off-command-state = "dsi_hs_mode";
						qcom,mdss-dsi-panel-phy-timings = [00 24 0a 0a 26 24 0a 0a 06 02 04 00 1e 1a];
						qcom,display-topology = <0x01 0x01 0x01>;
						qcom,default-topology-index = <0x00>;
					};
				};
			}